## components/plantower5003/Kconfig
```kconfig
menu "Dustsensor Parser"

    config DUSTSENSOR_PARSER_RING_BUFFER_SIZE
        int "NMEA Parser Ring Buffer Size"
        range 0 2048
        default 1024
        help
            Size of the ring buffer used for UART Rx channel.

    config DUSTSENSOR_PARSER_TASK_STACK_SIZE
        int "DUSTSENSOR Parser Task Stack Size"
        range 0 4096
        default 2048
        help
            Stack size of DUSTSENSOR Parser task.

    config DUSTSENSOR_PARSER_TASK_PRIORITY
        int "DUSTSENSOR Parser Task Priority"
        range 0 24
        default 2
        help
            Priority of DUSTSENSOR Parser task.

endmenu
```

## main/Kconfig.projbuild
```kconfig
menu "Example Configuration"

	choice DUSTSENSOR_UART_PORT
		prompt "Select the UART Port. Note: UART0 is disabled, this is used for debugging"
		default DUSTSENSOR_PORT_UART_1

		config DUSTSENSOR_UART_PORT_1
			bool "UART1"

		config DUSTSENSOR_UART_PORT_2
			bool "UART2"
	endchoice

	config DUSTSENSOR_UART_RX_PIN 
		int "UART GPIO number"
		range 0 34
		default 2 
		help
			GPIO number for the UART RX pin.

endmenu
```
